/*
 * Copyright (c) 2020 Gerson Fernando Budke
 *
 * SPDX-License-Identifier: Apache-2.0
 */

&spi0 {
        status = "disabled";
};

&usart1 {
	status = "okay";

	current-speed = <115200>;
	pinctrl-0 = <&pa21a_usart1_rxd1 &pa22a_usart1_txd1>;
};
