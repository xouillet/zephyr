## soc/arm/atmel_sam/sam4l/Kconfig.soc
```kconfig
# Atmel SAM4L MCU series
# Copyright (c) 2019 Gerson Fernando Budke
# SPDX-License-Identifier: Apache-2.0

choice
	prompt "Atmel SAM4L MCU Selection"
	depends on SOC_SERIES_SAM4L

	config SOC_PART_NUMBER_SAM4LS8C
		bool "SAM4LS8C"

	config SOC_PART_NUMBER_SAM4LS8B
		bool "SAM4LS8B"

	config SOC_PART_NUMBER_SAM4LS8A
		bool "SAM4LS8A"

	config SOC_PART_NUMBER_SAM4LS4C
		bool "SAM4LS4C"

	config SOC_PART_NUMBER_SAM4LS4B
		bool "SAM4LS4B"

	config SOC_PART_NUMBER_SAM4LS4A
		bool "SAM4LS4A"

	config SOC_PART_NUMBER_SAM4LS2C
		bool "SAM4LS2C"

	config SOC_PART_NUMBER_SAM4LS2B
		bool "SAM4LS2B"

	config SOC_PART_NUMBER_SAM4LS2A
		bool "SAM4LS2A"

	config SOC_PART_NUMBER_SAM4LC8C
		bool "SAM4LC8C"

	config SOC_PART_NUMBER_SAM4LC8B
		bool "SAM4LC8B"

	config SOC_PART_NUMBER_SAM4LC8A
		bool "SAM4LC8A"

	config SOC_PART_NUMBER_SAM4LC4C
		bool "SAM4LC4C"

	config SOC_PART_NUMBER_SAM4LC4B
		bool "SAM4LC4B"

	config SOC_PART_NUMBER_SAM4LC4A
		bool "SAM4LC4A"

	config SOC_PART_NUMBER_SAM4LC2C
		bool "SAM4LC2C"

	config SOC_PART_NUMBER_SAM4LC2B
		bool "SAM4LC2B"

	config SOC_PART_NUMBER_SAM4LC2A
		bool "SAM4LC2A"
endchoice

if SOC_SERIES_SAM4L

config SOC_ATMEL_SAM4L_EXT_SLCK
	bool "Atmel SAM4L to use external crystal oscillator for slow clock"
	help
	  Says y if you want to use external 32 kHz crystal
	  oscillator to drive the slow clock. Note that this
	  adds a few seconds to boot time, as the crystal
	  needs to stabilize after power-up.

	  Says n if you do not need accurate and precise timers.
	  The slow clock will be driven by the internal fast
	  RC oscillator running at 32 kHz.

config SOC_ATMEL_SAM4L_EXT_MAINCK
	bool "Atmel SAM4L to use external crystal oscillator for main clock"
	help
	  The main clock is being used to drive the PLL, and
	  thus driving the processor clock.

	  Says y if you want to use external crystal oscillator
	  to drive the main clock. Note that this adds about
	  a second to boot time, as the crystal needs to
	  stabilize after power-up.

	  The crystal used here can be from 0.6 to 30 MHz.

	  Says n here will use the internal fast RC oscillator
	  running at 12 MHz.

config SOC_ATMEL_SAM4L_PLLA_MULA
	hex "PLL MULA"
	default 0x03
	help
	  This is the multiplier (MULA) used by the PLL.
	  The processor clock is (MAINCK * (MULA + 1) / DIVA).

	  Board config file can override this settings
	  for a particular board.

	  With default of MULA == 3, and DIVA == 1,
	  PLL is running at 4 times of main clock.

config SOC_ATMEL_SAM4L_PLLA_DIVA
	hex "PLL DIVA"
	default 0x01
	help
	  This is the divider (DIVA) used by the PLL.
	  The processor clock is (MAINCK * (MULA + 1) / DIVA).

	  Board config file can override this settings
	  for a particular board.

	  With default of MULA == 3, and DIVA == 1,
	  PLL is running at 4 times of main clock.

config SOC_ATMEL_SAM4L_WAIT_MODE
	bool "Atmel SAM4L goes to Wait mode instead of Sleep mode"
	depends on SOC_ATMEL_SAM4L_EXT_MAINCK
	default y if DEBUG
	help
	  For JTAG debugging CPU clock (HCLK) should not stop. In order
	  to achieve this, make CPU go to Wait mode instead of Sleep
	  mode while using external crystal oscillator for main clock.

endif # SOC_SERIES_SAM4L
```

## soc/arm/gigadevice/Kconfig
```kconfig
# Copyright (c) 2021, ATL Electronics
# SPDX-License-Identifier: Apache-2.0

config SOC_FAMILY_GD32
	bool

if SOC_FAMILY_GD32

config SOC_FAMILY
	string
	default "gigadevice"

source "soc/arm/gigadevice/*/Kconfig.soc"

endif # SOC_FAMILY_GD32
```

## soc/riscv/bouffalolab/Kconfig
```kconfig
# Copyright (c) 2021, ATL Electronics
# SPDX-License-Identifier: Apache-2.0

config SOC_FAMILY_BL
	bool

if SOC_FAMILY_BL

config SOC_FAMILY
	string
	default "bouffalolab"

source "soc/riscv/bouffalolab/*/Kconfig.soc"

endif # SOC_FAMILY_BL
```

## soc/riscv/bouffalolab/bl/Kconfig.defconfig.series
```kconfig
# Copyright (c) 2021, ATL Electronics
# SPDX-License-Identifier: Apache-2.0

source "soc/riscv/bouffalolab/bl/Kconfig.defconfig.bl*"

# Configure default device drivers. If a feature is supported by more than one
# device driver the default configuration will be placed in the board defconfig
# file.

if SOC_SERIES_BL6

config UART_BL
	default y
	depends on SERIAL

endif   # SOC_SERIES_BL6
```

## soc/riscv/bouffalolab/bl/Kconfig.series
```kconfig
# Bouffalo Lab MCU line
#
# Copyright (c) 2021, ATL Electronics
# SPDX-License-Identifier: Apache-2.0

config SOC_SERIES_BL6
	bool "Bouffalo Lab BL6 series MCU"
	select RISCV
#	select RISCV_SOC_INIT_GP_VALUE
	select RISCV_HAS_CPU_IDLE
	select RISCV_MACHINE_TIMER
	select ATOMIC_OPERATIONS_C
	select COMPRESSED_ISA
	select SOC_FAMILY_BL
	select CPU_HAS_FPU
	select XIP
	help
	  Enable support for Bouffalo Lab BL6 MCU series
```

## soc/riscv/gigadevice/Kconfig
```kconfig
# Copyright (c) 2021, ATL Electronics
# SPDX-License-Identifier: Apache-2.0

config SOC_FAMILY_GD32
	bool

if SOC_FAMILY_GD32

config SOC_FAMILY
	string
	default "gigadevice"

source "soc/riscv/gigadevice/*/Kconfig.soc"

endif # SOC_FAMILY_GD32
```

## soc/riscv/gigadevice/gd32vf/Kconfig.defconfig.gd32vf103
```kconfig
# Copyright (c) 2021, ATL Electronics
# SPDX-License-Identifier: Apache-2.0

if SOC_SERIES_GD32VF103

config SOC_SERIES
	default "gd32vf"

config SOC_SUB_SERIES
	string
	default "gd32vf103"

config SOC_PART_NUMBER
	string
	default "gd32vf103c4t6" if SOC_PART_NUMBER_GD32VF103C4T6
	default "gd32vf103c6t6" if SOC_PART_NUMBER_GD32VF103C6T6
	default "gd32vf103c8t6" if SOC_PART_NUMBER_GD32VF103C8T6
	default "gd32vf103cbt6" if SOC_PART_NUMBER_GD32VF103CBT6
	default "gd32vf103r4t6" if SOC_PART_NUMBER_GD32VF103R4T6
	default "gd32vf103r6t6" if SOC_PART_NUMBER_GD32VF103R6T6
	default "gd32vf103r8t6" if SOC_PART_NUMBER_GD32VF103R8T6
	default "gd32vf103rbt6" if SOC_PART_NUMBER_GD32VF103RBT6
	default "gd32vf103t4u6" if SOC_PART_NUMBER_GD32VF103T4U6
	default "gd32vf103t6u6" if SOC_PART_NUMBER_GD32VF103T6U6

config SYS_CLOCK_HW_CYCLES_PER_SEC
	default 108000000

config NUM_IRQS
	default 86

# Configure default device drivers. If a feature is supported by more than one
# device driver the default configuration will be placed in the board defconfig
# file.

config USART_GD32
	default y
	depends on SERIAL

endif   # SOC_SERIES_GD32VF103
```

## soc/riscv/gigadevice/gd32vf/Kconfig.series
```kconfig
# GigaDevice GD32VF MCU line
#
# Copyright (c) 2021, ATL Electronics
# SPDX-License-Identifier: Apache-2.0

config SOC_SERIES_GD32VF103
	bool "GigaDevice GD32VF103 series MCU - Mainstream"
	select RISCV
	select RISCV_HAS_CPU_IDLE
	select ATOMIC_OPERATIONS_C
	select SOC_FAMILY_GD32
	select COMPRESSED_ISA
	select NUCLEI_ECLIC
	help
	  Enable support for GigaDevice GD32VF103 MCU series
```

## soc/riscv/gigadevice/gd32vf/Kconfig.soc
```kconfig
# Copyright (c) 2021, ATL Electronics
# SPDX-License-Identifier: Apache-2.0

source "soc/riscv/gigadevice/gd32vf/Kconfig.soc.gd32vf103"
```

## soc/riscv/gigadevice/gd32vf/Kconfig.soc.gd32vf103
```kconfig
# Copyright (c) 2021, ATL Electronics
# SPDX-License-Identifier: Apache-2.0

choice
	prompt "GigaDevice GD32VF103 MCU Selection"
	depends on SOC_SERIES_GD32VF103

	config SOC_PART_NUMBER_GD32VF103C4T6
		bool "GD32VF103C4T6"

	config SOC_PART_NUMBER_GD32VF103C6T6
		bool "GD32VF103C6T6"

	config SOC_PART_NUMBER_GD32VF103C8T6
		bool "GD32VF103C8T6"

	config SOC_PART_NUMBER_GD32VF103CBT6
		bool "GD32VF103CBT6"

	config SOC_PART_NUMBER_GD32VF103R4T6
		bool "GD32VF103R4T6"

	config SOC_PART_NUMBER_GD32VF103R6T6
		bool "GD32VF103R6T6"

	config SOC_PART_NUMBER_GD32VF103R8T6
		bool "GD32VF103R8T6"

	config SOC_PART_NUMBER_GD32VF103RBT6
		bool "GD32VF103RBT6"

	config SOC_PART_NUMBER_GD32VF103T4U6
		bool "GD32VF103T4U6"

	config SOC_PART_NUMBER_GD32VF103T6U6
		bool "GD32VF103T6U6"
endchoice
```
