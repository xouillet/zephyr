## dts/bindings/flash_controller/atmel,sam-flashcalw-controller.yaml
```yaml
# Copyright (c) 2018, Aurelien Jarno
# Copyright (c) 2020, Gerson Fernando Budke <nandojve@gmail.com>
#
# SPDX-License-Identifier: Apache-2.0

description: Atmel SAM FLASH Controller Double-Word (FLASHCALW)

compatible: "atmel,sam-flashcalw-controller"

include: flash-controller.yaml

properties:
    peripheral-id:
      type: int
      description: peripheral ID
      required: true
```

## dts/bindings/i2c/atmel,sam-i2c-twim.yaml
```yaml
# Copyright (c) 2020 Gerson Fernando Budke <nandojve@gmail.com>
# SPDX-License-Identifier: Apache-2.0

description: Atmel SAM Family I2C (TWIM) node

compatible: "atmel,sam-i2c-twim"

include: i2c-controller.yaml

properties:
    reg:
      required: true

    interrupts:
      required: true

    peripheral-id:
      type: int
      required: true
      description: peripheral ID

    std-clk-slew-lim:
        type: int
        description: Slew limit of the TWCK output buffer
        default: 0

    std-clk-strenght-low:
        type: int
        description: Pull-down drive strength of the TWCK output buffer
        default: 0

    std-data-slew-lim:
        type: int
        description: Slew limit of the TWD output buffer
        default: 0

    std-data-strenght-low:
        type: int
        description: Pull-down drive strength of the TWD output buffer
        default: 0

    hs-clk-slew-lim:
        type: int
        description: |
          Slew limit of the TWCK output buffer in high speed mode
        default: 0

    hs-clk-strenght-high:
        type: int
        description: |
          Pull-up drive strength of the TWCK output buffer in high
          speed mode
        default: 0

    hs-clk-strenght-low:
        type: int
        description: |
          Pull-down drive strength of the TWCK output buffer in high
          speed mode
        default: 0

    hs-data-slew-lim:
        type: int
        description: |
          Slew limit of the TWD output buffer in high speed mode
        default: 0

    hs-data-strenght-low:
        type: int
        description: |
          Pull-down drive strength of the TWD output buffer in high
          speed mode
        default: 0

    hs-master-code:
        type: int
        description: |
          3-bit code to be prefixed with 0b00001 to form a unique
          8-bit HS-mode master code (0000 1XXX)
        default: 0

    pinctrl-0:
      type: phandles
      required: true
      description: |
        GPIO pin configuration for TWCK & TWD signals. We expect that
        the phandles will reference pinctrl nodes. These nodes will
        have a nodelabel that matches the Atmel SoC HAL defines and
        be of the form p<port><pin><periph>_<inst>_<signal>.

        For example the I2C on SAM4L would be
           pinctrl-0 = <&pb0a_twi1_twd1 &pb1a_twi1_twck1>;
```

## dts/bindings/i2c/atmel,sam-i2c-twis.yaml
```yaml
# Copyright (c) 2019 Gerson Fernando Budke
# SPDX-License-Identifier: Apache-2.0

description: Atmel SAM Family I2C (TWIS) node

compatible: "atmel,sam-i2c-twis"

include: i2c-controller.yaml

properties:
    reg:
      required: true

    interrupts:
      required: true

    peripheral-id:
      type: int
      description: peripheral ID
      required: true
```

## dts/bindings/riscv/riscv,cpus.yaml
```yaml
# Copyright (c) 2021 Gerson Fernando Budke <nandojve@gmail.com>
# SPDX-License-Identifier: Apache-2.0

# Import from devicetree/bindings/riscv/cpus.yaml

include: cpu.yaml

description: |
  This document uses some terminology common to the RISC-V community
  that is not widely used, the definitions of which are listed here:

  hart: A hardware execution context, which contains all the state
  mandated by the RISC-V ISA: a PC and some registers.  This
  terminology is designed to disambiguate software's view of execution
  contexts from any particular microarchitectural implementation
  strategy.  For example, an Intel laptop containing one socket with
  two cores, each of which has two hyperthreads, could be described as
  having four harts.

  NOTE: riscv compatible should be used for simulator only

  - |
    // Example 1: SiFive Freedom U540G Development Kit
    cpus {
        #address-cells = <1>;
        #size-cells = <0>;
        timebase-frequency = <1000000>;
        cpu@0 {
                clock-frequency = <0>;
                compatible = "sifive,rocket0", "riscv";
                device_type = "cpu";
                i-cache-block-size = <64>;
                i-cache-sets = <128>;
                i-cache-size = <16384>;
                reg = <0>;
                riscv,isa = "rv64imac";
                cpu_intc0: interrupt-controller {
                        #interrupt-cells = <1>;
                        compatible = "riscv,cpu-intc";
                        interrupt-controller;
                };
        };
        cpu@1 {
                clock-frequency = <0>;
                compatible = "sifive,rocket0", "riscv";
                d-cache-block-size = <64>;
                d-cache-sets = <64>;
                d-cache-size = <32768>;
                d-tlb-sets = <1>;
                d-tlb-size = <32>;
                device_type = "cpu";
                i-cache-block-size = <64>;
                i-cache-sets = <64>;
                i-cache-size = <32768>;
                i-tlb-sets = <1>;
                i-tlb-size = <32>;
                mmu-type = "riscv,sv39";
                reg = <1>;
                riscv,isa = "rv64imafdc";
                tlb-split;
                cpu_intc1: interrupt-controller {
                        #interrupt-cells = <1>;
                        compatible = "riscv,cpu-intc";
                        interrupt-controller;
                };
        };
    };

  - |
    // Example 2: Spike ISA Simulator with 1 Hart
    cpus {
        #address-cells = <1>;
        #size-cells = <0>;
        cpu@0 {
                device_type = "cpu";
                reg = <0>;
                compatible = "riscv";
                riscv,isa = "rv64imafdc";
                mmu-type = "riscv,sv48";
                interrupt-controller {
                        #interrupt-cells = <1>;
                        interrupt-controller;
                        compatible = "riscv,cpu-intc";
                };
        };
    };

properties:
  mmu-type:
    description: |
      Identifies the MMU address translation mode used on this
      hart.  These values originate from the RISC-V Privileged
      Specification document, available from
      https://riscv.org/specifications/
    required: false
    type: string
    enum:
      - riscv,sv32
      - riscv,sv39
      - riscv,sv48
      - riscv,none

  riscv,isa:
    description: |
      Identifies the specific RISC-V instruction set architecture
      supported by the hart.  These are documented in the RISC-V
      User-Level ISA document, available from
      https://riscv.org/specifications/

      While the isa strings in ISA specification are case
      insensitive, letters in the riscv,isa string must be all
      lowercase to simplify parsing.
    required: true
    type: string
    enum:
      - rv32imac
      - rv32imafc
      - rv32imafcb
      - rv64imac
      - rv64imafdc

  riscv,pmpregions:
    description: |
      Physical Memory Protection (PMP) is a part of the RISC-V Privileged
      Architecture Specification which discribes the interface for a standard
      RISC-V memory protection unit.

      The PMP defines a finite number of PMP regions which can be individually
      configured to enforce access permissions to a range of addresses in
      memory.
    required: true
    type: int
```

## dts/bindings/serial/bouffalolab,bl-uart.yaml
```yaml
# Copyright (c) 2021, ATL Electronics
# SPDX-License-Identifier: Apache-2.0

description: Bouffalo Lab UART

compatible: "bouffalolab,bl-uart"

include: uart-controller.yaml

properties:
    reg:
      required: true

    peripheral-id:
      type: int
      description: peripheral ID
      required: true
```

## dts/bindings/serial/gigadevice,gd32-usart.yaml
```yaml
# Copyright (c) 2021, ATL Electronics
# SPDX-License-Identifier: Apache-2.0

description: GigaDevice USART

compatible: "gigadevice,gd32-usart"

include: uart-controller.yaml

properties:
    reg:
      required: true

    peripheral-id:
      type: int
      description: peripheral ID
      required: true
```

## dts/bindings/sigfox/st,s2lp.yaml
```yaml
# Copyright (c) 2020 Gerson Fernando Budke <nandojve@gmail.com>
# SPDX-License-Identifier: Apache-2.0

description: ST Ultra-low power, high performance, sub-1 GHz transceiver

compatible: "st,s2lp"

include: spi-device.yaml

properties:
    sdn-gpios:
      type: phandle-array
      required: true
      description: Shutdown signal. SDN should be level low all time, except
        shutdown mode.

    dio0-function:
      type: int
      required: false
      default: 0x0A
      description: General purpose in/out pin 0 function. This s2-lp pin can
        be routed to dio0-gpios handle. Default VDD.

    dio0-gpios:
      type: phandle-array
      required: false
      description: General purpose in/out pin 0.

    dio1-function:
      type: int
      required: false
      default: 0xA2
      description: General purpose in/out pin 1 function. This s2-lp pin can
        be routed to dio1-gpios handle. Default VDD.

    dio1-gpios:
      type: phandle-array
      required: false
      description: General purpose in/out pin 1.

    dio2-function:
      type: int
      required: false
      default: 0xA2
      description: General purpose in/out pin 2 function. This s2-lp pin can
        be routed to dio2-gpios handle. Default VDD.

    dio2-gpios:
      type: phandle-array
      required: false
      description: General purpose in/out pin 2.

    dio3-function:
      type: int
      required: false
      default: 0xA2
      description: General purpose in/out pin 3 function. This s2-lp pin can
        be routed to dio3-gpios handle. Default VDD.

    dio3-gpios:
      type: phandle-array
      required: false
      description: General purpose in/out pin 3.

    trx-clock-frequency:
      type: int
      required: true
      description: Transceiver input clock frequency

    trx-start-duration:
      type: int
      required: false
      default: 18
      description: Transceiver modulation ramp start duration

    trx-fdev-neg:
      type: int
      required: false
      default: 0x81
      description: Transceiver frequency deviation negative value

    trx-fdev-pos:
      type: int
      required: false
      default: 0x7f
      description: Transceiver frequency deviation positive value

    trx-min-power:
      type: int
      required: false
      default: 220
      description: Transceiver min output power

    trx-max-power:
      type: int
      required: false
      default: 1
      description: Transceiver max output power

    trx-gain-f1:
      type: int
      required: false
      default: 0
      description: Transceiver modulation ramp gain factor 1

    trx-gain-f2:
      type: int
      required: false
      default: 0
      description: Transceiver modulation ramp gain factor 2

    trx-ext-pa:
      type: boolean
      required: false
      description: Transceiver should enable external PA at TX

    trx-ext-lna:
      type: boolean
      required: false
      description: Transceiver should enable external LNA at RX
```

## dts/bindings/watchdog/atmel,sam-tw-watchdog.yaml
```yaml
# Copyright (c) 2019, Gerson Fernando Budke
# SPDX-License-Identifier: Apache-2.0

description: |
    ATMEL SAM Timing Window Watchdog (TWW). The TWW works with a 32-bit
    timer counter. This component may be enabled at reset by a fuse. The
    default clock is RCSYS which runs at 115kHz.

compatible: "atmel,sam-tw-watchdog"

include: base.yaml

properties:
    reg:
      required: true

    label:
      required: true

    interrupts:
      required: true

    peripheral-id:
      type: int
      description: peripheral ID
      required: true

    psel:
      type: int
      description: |
          Time Out Prescale. Counter bit PSEL is used as watchdog timeout
          period. The minimal value is 7 and max value is 31. This represents
          2pow(PSEL+1) clocks to overflow. The default value is 16 to achieve
          1.139756522s to overflow.
      required: true

    tban:
      type: int
      description: |
          Time Ban Prescale. Counter bit TBAN is used as watchdog “banned”
          time frame. In this time frame clearing the WDT timer is forbidden,
          otherwise a watchdog reset is generated and the WDT timer is cleared.
          The presence of this property at Device Tree enables Windowing mode,
          otherwise basic mode is activated. The minimal value is 7 and max
          value is 31.
      required: false
```

## samples/net/gsm_modem/boards/frdm_k64f.conf
```kconfig
#
# Copyright (c) 2020 Gerson Fernando Budke
#
# SPDX-License-Identifier: Apache-2.0
#

# Configure USART-1 => EXT-1
# Tested with SIM808
CONFIG_MODEM_GSM_UART_NAME="arduino_serial"
CONFIG_MODEM_GSM_APN="zap.vivo.com.br"
CONFIG_TEST_RANDOM_GENERATOR=y

CONFIG_DEVICE_SHELL=y
CONFIG_NET_L2_PPP_MGMT=y

CONFIG_NET_TCP=y
CONFIG_NET_TCP_BACKLOG_SIZE=4
CONFIG_NET_MAX_CONN=6

CONFIG_DNS_RESOLVER=y
```

## samples/net/sockets/echo_client/boards/byond_megaz0rd.conf
```kconfig
#
# Copyright (c) 2020, Gerson Fernando Budke
#
# SPDX-License-Identifier: Apache-2.0
#

CONFIG_NET_L2_IEEE802154=y
CONFIG_IEEE802154_RF2XX=y

CONFIG_NET_6LO=y
CONFIG_NET_L2_IEEE802154_FRAGMENT=y
CONFIG_NET_L2_IEEE802154_FRAGMENT_REASS_CACHE_SIZE=2
CONFIG_NET_L2_IEEE802154_SECURITY=n

CONFIG_NET_CONFIG_MY_IPV6_ADDR="2001:db8::1"
CONFIG_NET_CONFIG_PEER_IPV6_ADDR="2001:db8::2"
CONFIG_NET_CONFIG_IEEE802154_DEV_NAME="RF2XX_0"

CONFIG_DEVICE_SHELL=y
CONFIG_CPLUSPLUS=n

CONFIG_NET_L2_ETHERNET=n
CONFIG_ETH_SAM_GMAC=n
CONFIG_I2C=n
CONFIG_GPIO_SAM=y
CONFIG_GPIO=y
CONFIG_SPI=y
CONFIG_SPI_SAM=y
CONFIG_SPI_SAM_PORT_0=y
CONFIG_SPI_SAM_PORT_0_PIN_CS0_PA11=y

CONFIG_KERNEL_SHELL=y
CONFIG_REBOOT=y
```
