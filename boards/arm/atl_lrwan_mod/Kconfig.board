## drivers/sigfox/Kconfig.st_s2lp
```kconfig
#
# Copyright (c) 2020 Gerson Fernando Budke
#
# SPDX-License-Identifier: Apache-2.0
#

menuconfig SIGFOX_S2LP
	bool "ST S2-LP driver"
	select SPI
	select GPIO
	help
	  Enable Sigfox driver for ST S2-LP.

if SIGFOX_S2LP

module = SIGFOX_S2LP
module-str = sigfox_s2lp
source "subsys/logging/Kconfig.template.log_config"

config SIGFOX_S2LP_TX_BY_FIFO_EMPTY_DIO
	bool "Enable ISR dio to be used as FIFO empty flag on TX"
	default y
	help
	  This enable driver to do an spin lock at TX phase. This is the
	  recommended way to use. It is mandatory use on slow MCUs that can't
	  react fast enought to receive an interrupt, read ISR flags, and
	  process next TX tick.

	  CAUTION: When using any kind of log TX can be severe afected by this
	  option.

config SIGFOX_S2LP_ERRATA_SDO_PIN_NOT_TRI_STATED
	bool "S2-LPQTR cut 2.1 SDO pin not tri-stated"
	default y
	help
	  Enable workaround for S2-LPQTR cut 2.1 SDO pin not tri-stated. Each
	  time an application needs to access another SPI slave, turn the
	  S2-LP off via the SDN pin.

config SIGFOX_S2LP_RX_STACK_SIZE
	int "Driver's internal RX thread stack size"
	default 512
	help
	  This option sets the driver's stack size for its internal RX thread.
	  The default value should be sufficient, but in case it proves to be
	  a too little one, this option makes it easy to play with the size.

config SIGFOX_S2LP_HAS_TXCO
	bool "Indicate that transceiver clock source is a TCXO oscilator"

config SIGFOX_S2LP_HAS_EXTERNAL_PA_LNA
	bool "Indicate that transceiver is connected to an external PA/LNA"

config SIGFOX_S2LP_CUSTOM_EXTERNAL_PA_LNA
	bool "Custom transceiver external PA/LNA handle"
	depends on SIGFOX_S2LP_HAS_EXTERNAL_PA_LNA
	help
	  This option enable custom PA/LNA handling

endif
```

## dts/bindings/clock/atmel,sam4l-pm.yaml
```yaml
# Copyright (c) 2020 Gerson Fernando Budke <nandojve@gmail.com>
# SPDX-License-Identifier: Apache-2.0

description: Atmel SAM4L Power Manager (PM)

compatible: "atmel,sam4l-pm"

include: [clock-controller.yaml, base.yaml]

properties:
    reg:
      required: true

    peripheral-id:
      type: int
      description: peripheral ID
      required: true

    clock-output-names:
      type: string-array
      required: true

    clock-frequency:
      type: array
      required: true

    pba-div:
      type: int
      required: true
      default: 0

    pbb-div:
      type: int
      required: true
      default: 0

    pbc-div:
      type: int
      required: true
      default: 0

    pbd-div:
      type: int
      required: true
      default: 0

    "#clock-cells":
      const: 1
```

## dts/bindings/clock/pll-clock.yaml
```yaml
# Copyright (c) 2020 Gerson Fernando Budke <nandojve@gmail.com>
# Copyright (c) 2019 Derek Hageman <hageman@inthat.cloud>
# SPDX-License-Identifier: Apache-2.0

description: Generic pll-rate clock provider

compatible: "pll-clock"

include: clock-controller.yaml

properties:
    label:
      type: string
      required: false
      description: Human readable string describing the device (used by Zephyr for API name)

    clock-frequency:
      type: int
      description: output clock frequency (Hz)
      required: true

    pll-mul:
      type: int
      description: PLL multiply factor
      required: true

    pll-div:
      type: int
      description: PLL division factor
      required: true

    pll-count:
      type: int
      description: Specifies the number of refclk cycles before try to lock
      required: false

    pll-range:
      type: int
      description: Selects the frequency range
      required: false

    pll-out-div:
      type: int
      description: Divides the output frequency divisor
      required: false
      default: 0

    pll-calib:
      type: int
      description: Sets the calibration value
      required: false

    clocks:
      type: phandle-array
      required: false
      description: input clock source

    clock-id:
      type: int
      required: false
      description: Clock identificator

    "#clock-cells":
      const: 0
```

## dts/bindings/cpu/cpu.yaml
```yaml
# Copyright (c) 2019 Nordic Semiconductor ASA
# SPDX-License-Identifier: Apache-2.0

# Common fields for CPUs

include: base.yaml

properties:
    timebase-frequency:
      type: int
      required: false
      description: |
        A cell indicating the frequency of the timebase in Hz. This is not
        directly used by the generic code, but you are welcome to copy/paste
        the pSeries code for setting the kernel timebase/decrementer
        calibration based on this value.
    clock-frequency:
      type: int
      required: false
      description: |
        A cell indicating the CPU core clock frequency in Hz. A new property
        will be defined for 64-bit values, but if your frequency is < 4Ghz,
        one cell is enough. Here as well as for the above, the common code
        doesn't use that property, but you are welcome to re-use the pSeries
        or Maple one. A future kernel version might provide a common function
        for this.
    cpu-power-states:
      type: phandles
      required: false
      description: |
        List of power management states supported by this cpu
    i-cache-line-size:
      type: int
      required: false
      description: |
        One cell, L1 data cache line size in bytes if different from the
        block size.
    d-cache-line-size:
      type: int
      required: false
      description: |
        One cell, L1 instruction cache line size in bytes if different from
        the block size.
```
