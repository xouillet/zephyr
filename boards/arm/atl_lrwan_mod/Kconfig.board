## boards/arm/atl_lrwan_mod/Kconfig.board
```kconfig
# ATL-Electronics LoRaWAN Module

# Copyright (c) 2020 Aleksandr Makarov <aleksandr.o.makarov@gmail.com>
# Copyright (c) 2020 ATL-Electronics
# SPDX-License-Identifier: Apache-2.0

config BOARD_ATL_LRWAN_MOD
	bool "ATL-Electronics LoRaWAN Module"
	depends on SOC_STM32L072XX
```

## boards/arm/atl_lrwan_mod/Kconfig.defconfig
```kconfig
# ATL-Electronics LoRaWAN Module

# Copyright (c) 2018 Aleksandr Makarov <aleksandr.o.makarov@gmail.com>
# Copyright (c) 2020 ATL-Electronics
# SPDX-License-Identifier: Apache-2.0

if BOARD_ATL_LRWAN_MOD

config BOARD
	default "atl_lrwan_mod"

choice COUNTER_RTC_STM32_CLOCK_SRC
	default COUNTER_RTC_STM32_CLOCK_LSE
	depends on COUNTER
endchoice # COUNTER_RTC_STM32_CLOCK_SRC

config LORA_SX12XX
	default y
	depends on LORA

config SPI
	default y
	depends on LORA

config GPIO
	default y
	depends on LORA

endif # BOARD_ATL_LRWAN_MOD
```

## boards/arm/byond_megaz0rd/Kconfig.board
```kconfig
# Copyright (c) 2019-2020 Gerson Fernando Budke
# SPDX-License-Identifier: Apache-2.0

config BOARD_BYOND_MEGAZ0RD
	bool "Byond MagaZ0rd"
	depends on SOC_PART_NUMBER_SAM4E16C
```

## boards/arm/byond_megaz0rd/Kconfig.defconfig
```kconfig
# Copyright (c) 2019-2020 Gerson Fernando Budke
# SPDX-License-Identifier: Apache-2.0

if BOARD_BYOND_MEGAZ0RD

config BOARD
	default "byond_megaz0rd"

if NETWORKING

config NET_L2_ETHERNET
	default y

config ETH_SAM_GMAC
	default y if NET_L2_ETHERNET

endif # NETWORKING

endif # BOARD_BYOND_MEGAZ0RD
```

## boards/arm/byond_megaz0rd/byond_megaz0rd_defconfig
```kconfig
# SPDX-License-Identifier: Apache-2.0

CONFIG_SOC_SERIES_SAM4E=y
CONFIG_SOC_PART_NUMBER_SAM4E16C=y
CONFIG_SOC_ATMEL_SAM4E_EXT_MAINCK=y

CONFIG_ARM_MPU=y
CONFIG_CORTEX_M_SYSTICK=y

CONFIG_BOARD_BYOND_MEGAZ0RD=y
CONFIG_UART_CONSOLE=y
CONFIG_CONSOLE=y
CONFIG_SERIAL=y
CONFIG_USART_SAM=y
CONFIG_UART_SAM=y
CONFIG_UART_INTERRUPT_DRIVEN=y
CONFIG_GPIO=y
CONFIG_PINMUX=y

CONFIG_WDT_DISABLE_AT_BOOT=y

# Enable HW stack protection
CONFIG_HW_STACK_PROTECTION=y
```

## boards/arm/byond_nrf51422_dongle/Kconfig.board
```kconfig
# Copyright (c) 2020 Gerson Fernando Budke <nandojve@gmail.com>
# SPDX-License-Identifier: Apache-2.0

config BOARD_BYOND_NRF51422_DONGLE
	bool "Byond NRF51422 dongle"
	depends on SOC_NRF51822_QFAC
```

## boards/arm/byond_nrf51422_dongle/Kconfig.defconfig
```kconfig
# Copyright (c) 2020 Linaro Limited.
# SPDX-License-Identifier: Apache-2.0

if BOARD_BYOND_NRF51422_DONGLE

config BOARD
	default "Byond nrf51422 Dongle"

config I2C_0
	default y
	depends on I2C

config SPI_1
	default y
	depends on SPI

config BT_CTLR
	default BT

endif # BOARD_BYOND_NRF51422_DONGLE
```

## boards/arm/ht32sx_nano/Kconfig.board
```kconfig
# Copyright (c) 2020 Gerson Fernando Budke <nandojve@gmail.com>
# SPDX-License-Identifier: Apache-2.0

config BOARD_HT32SX_NANO
	bool "HT-MICRON iMCP HT32SX Nano Board"
	depends on SOC_STM32L053XX
```

## boards/arm/sam4l_wm400_cape/Kconfig.defconfig
```kconfig
# Atmel SAM4L WM-400 BBB Cape Board configuration

# Copyright (c) 2019 Gerson Fernando Budke
# SPDX-License-Identifier: Apache-2.0

if BOARD_SAM4L_WM400_CAPE

config BOARD
	default "sam4l_wm400_cape"

if USART_SAM_PORT_0

choice USART_SAM_PORT_0_PIN_RXD
	default USART_SAM_PORT_0_PIN_RXD_PB14
endchoice

choice USART_SAM_PORT_0_PIN_TXD
	default USART_SAM_PORT_0_PIN_TXD_PB15
endchoice

endif

if USART_SAM_PORT_1

choice USART_SAM_PORT_1_PIN_RXD
	default USART_SAM_PORT_1_PIN_RXD_PA15
endchoice

choice USART_SAM_PORT_1_PIN_TXD
	default USART_SAM_PORT_1_PIN_TXD_PA16
endchoice

endif

config SPI_SAM_PORT_0
	default y
	depends on SPI_SAM

config IEEE802154_RF2XX
	default y
	depends on IEEE802154

endif # BOARD_SAM4L_WM400_CAPE
```

## boards/arm/sam4l_wm400_cape/sam4l_wm400_cape_defconfig
```kconfig
# SPDX-License-Identifier: Apache-2.0

CONFIG_SOC_SERIES_SAM4L=y
CONFIG_SOC_PART_NUMBER_SAM4LC4B=y
CONFIG_CORTEX_M_SYSTICK=y
CONFIG_CONSOLE=y
CONFIG_UART_CONSOLE=y
CONFIG_SERIAL=y
CONFIG_BOARD_SAM4L_WM400_CAPE=y
CONFIG_USE_DT_CODE_PARTITION=y
CONFIG_SOC_ATMEL_SAM4L_EXT_MAINCK=y
CONFIG_WATCHDOG=n
CONFIG_SPI=y
CONFIG_GPIO=y
CONFIG_LED=y
CONFIG_SHELL=y
CONFIG_DEVICE_SHELL=y
CONFIG_I2C=y
CONFIG_USB=y
```

## boards/arm/sip_ht32sx/Kconfig.board
```kconfig
# Copyright (c) 2020 Gerson Fernando Budke <nandojve@gmail.com>
# SPDX-License-Identifier: Apache-2.0

config BOARD_SIP_HT32SX
	bool "HT-MICRON iCMP HT32SX SIP Sigfox"
	depends on SOC_STM32L053XX
```

## boards/arm/sip_ht32sx/Kconfig.defconfig
```kconfig
# Copyright (c) 2020 Gerson Fernando Budke <nandojve@gmail.com>
# SPDX-License-Identifier: Apache-2.0

if BOARD_SIP_HT32SX

config BOARD
	default "sip_ht32sx"

config SPI_STM32_DMA
	default y
	depends on SPI

config SPI_STM32_INTERRUPT
	default n
	depends on SPI

config SPI_STM32_USE_HW_SS
	default n
	depends on SPI

config SIGFOX_S2LP
	default y
	depends on SIGFOX

config SIGFOX_S2LP_ERRATA_SDO_PIN_NOT_TRI_STATED
	default y
	depends on SIGFOX_S2LP

config SIGFOX_S2LP_RX_STACK_SIZE
	default 512
	depends on SIGFOX_S2LP

config SIGFOX_S2LP_HAS_EXTERNAL_PA_LNA
	default y
	depends on SIGFOX_S2LP

endif # BOARD_SIP_HT32SX
```

## boards/riscv/sipeed_logan_nano/Kconfig.board
```kconfig
# Sipeed Logan Nano with GigaDevice GD32VF103CBT6
#
# Copyright (c) 2021, ATL Electronics
# SPDX-License-Identifier: Apache-2.0

config BOARD_SIPEED_LOGAN_NANO
	bool "Sipeed Logan Nano with GigaDevice GD32VF103CBT6"
	depends on SOC_PART_NUMBER_GD32VF103CBT6
```

## boards/riscv/sipeed_logan_nano/Kconfig.defconfig
```kconfig
# Sipeed Logan Nano with GigaDevice GD32VF103CBT6
#
# Copyright (c) 2021, ATL Electronics
# SPDX-License-Identifier: Apache-2.0

if BOARD_SIPEED_LOGAN_NANO

config BOARD
	default "sipeed_logan_nano"

config BOARD_CLOCK
	int
	default 8000000

endif   # BOARD_SIPEED_LOGAN_NANO
```

## boards/riscv/sipeed_logan_nano/sipeed_logan_nano_defconfig
```kconfig
#
# Copyright (c) 2021, ATL Electronics
#
# SPDX-License-Identifier: Apache-2.0
#

CONFIG_SOC_SERIES_GD32VF103=y
CONFIG_SOC_PART_NUMBER_GD32VF103CBT6=y
CONFIG_BOARD_SIPEED_LOGAN_NANO=y

# 108MHz for system clock
CONFIG_SYS_CLOCK_HW_CYCLES_PER_SEC=108000000

# 27MHz for machine timer
CONFIG_RISCV_MACHINE_TIMER=y
CONFIG_RISCV_MACHINE_TIMER_CLOCK_FREQUENCY=27000000

CONFIG_RISCV_SOC_MCAUSE_EXCEPTION_MASK=0x7FF

CONFIG_CONSOLE=y
CONFIG_UART_CONSOLE=y
CONFIG_SERIAL=y
CONFIG_PRINTK=y
```

## drivers/gpio/Kconfig.sam
```kconfig
# Atmel SAM GPIO configuration options

# Copyright (c) 2018 Justin Watson
# SPDX-License-Identifier: Apache-2.0

config GPIO_SAM
	bool "Atmel SAM GPIO (PORT) driver"
	default y
	depends on SOC_FAMILY_SAM && !SOC_SERIES_SAM4L
	select HAS_DTS_GPIO
	help
	  Enable support for the Atmel SAM 'PORT' GPIO controllers.

config GPIO_SAM4L
	bool "Atmel SAM GPIO (PORT) driver"
	default y
	depends on SOC_SERIES_SAM4L
	select HAS_DTS_GPIO
	help
	  Enable support for the Atmel SAM 'PORT' GPIO controllers.
```

## drivers/serial/Kconfig.bl
```kconfig
# Bouffalo Lab UART configuration
#
# Copyright (c) 2021 ATL Electronics
# SPDX-License-Identifier: Apache-2.0

config UART_BL
	bool "Bouffalo Lab serial driver"
	depends on SOC_FAMILY_BL
	select SERIAL_HAS_DRIVER
	help
	  This option enables the UART driver for Bouffalo Lab SoC family.
```

## drivers/serial/Kconfig.gd32
```kconfig
# GigaDevice USART configuration
#
# Copyright (c) 2021 ATL Electronics
# SPDX-License-Identifier: Apache-2.0

config USART_GD32
	bool "GD32 serial driver"
	depends on SOC_FAMILY_GD32
	select SERIAL_HAS_DRIVER
	help
	  This option enables the USART driver for GD32 SoC family.
```

## drivers/serial/Kconfig.usart_sam
```kconfig
# Atmel SAM USART configuration options

# Copyright (c) 2016 Piotr Mienkowski
# SPDX-License-Identifier: Apache-2.0

menuconfig USART_SAM
	bool "Atmel SAM MCU family USART driver"
	depends on SOC_FAMILY_SAM
	select SERIAL_HAS_DRIVER
	select SERIAL_SUPPORT_INTERRUPT
	help
	  This option enables the USARTx driver for Atmel SAM MCUs.

# ---------- Port 0 ----------

config USART_SAM_PORT_0
	bool "Enable USART0"
	depends on USART_SAM
	help
	  Enable USART0 at boot

# ---------- Port 1 ----------

config USART_SAM_PORT_1
	bool "Enable USART1"
	depends on USART_SAM
	help
	  Enable USART1 at boot

# ---------- Port 2 ----------

config USART_SAM_PORT_2
	bool "Enable USART2"
	depends on USART_SAM
	help
	  Enable USART2 at boot

# ---------- Port 3 ----------

config USART_SAM_PORT_3
	bool "Enable USART3"
	depends on USART_SAM
	depends on SOC_SERIES_SAM4L
	help
	  Enable USART3 at boot

source "drivers/serial/Kconfig.usart_sam4l"
```

## drivers/serial/Kconfig.usart_sam4l
```kconfig
# Atmel SAM4L USART configuration options

# Copyright (c) 2020 Piotr Mienkowski
# SPDX-License-Identifier: Apache-2.0

# ---------- Port 0 ----------

choice USART_SAM_PORT_0_PIN_RTS
	prompt "RTS pin"
	depends on SOC_SERIES_SAM4L
	depends on USART_SAM_PORT_0

	config USART_SAM_PORT_0_PIN_RTS_PA6
		bool "PA6"

	config USART_SAM_PORT_0_PIN_RTS_PA8
		bool "PA8"

	config USART_SAM_PORT_0_PIN_RTS_PB12
		bool "PB12"

	config USART_SAM_PORT_0_PIN_RTS_PC1
		bool "PC1"

endchoice

choice USART_SAM_PORT_0_PIN_CTS
	prompt "CTS pin"
	depends on SOC_SERIES_SAM4L
	depends on USART_SAM_PORT_0

	config USART_SAM_PORT_0_PIN_CTS_PA9
		bool "PA9"

	config USART_SAM_PORT_0_PIN_CTS_PB11
		bool "PB11"

	config USART_SAM_PORT_0_PIN_CTS_PC2
		bool "PC2"

endchoice

choice USART_SAM_PORT_0_PIN_CLK
	prompt "CLK pin"
	depends on SOC_SERIES_SAM4L
	depends on USART_SAM_PORT_0

	config USART_SAM_PORT_0_PIN_CLK_PA4
		bool "PA4"

	config USART_SAM_PORT_0_PIN_CLK_PA10
		bool "PA10"

	config USART_SAM_PORT_0_PIN_CLK_PB13
		bool "PB13"

	config USART_SAM_PORT_0_PIN_CLK_PC0
		bool "PC0"

endchoice

choice USART_SAM_PORT_0_PIN_RXD
	prompt "RXD pin"
	depends on SOC_SERIES_SAM4L
	depends on USART_SAM_PORT_0

	config USART_SAM_PORT_0_PIN_RXD_PA5
		bool "PA5"

	config USART_SAM_PORT_0_PIN_RXD_PA11
		bool "PA11"

	config USART_SAM_PORT_0_PIN_RXD_PB0
		bool "PB0"

	config USART_SAM_PORT_0_PIN_RXD_PB14
		bool "PB14"

	config USART_SAM_PORT_0_PIN_RXD_PC2
		bool "PC2"

endchoice

choice USART_SAM_PORT_0_PIN_TXD
	prompt "TXD pin"
	depends on SOC_SERIES_SAM4L
	depends on USART_SAM_PORT_0

	config USART_SAM_PORT_0_PIN_TXD_PA7
		bool "PA7"

	config USART_SAM_PORT_0_PIN_TXD_PA12
		bool "PA12"

	config USART_SAM_PORT_0_PIN_TXD_PB1
		bool "PB1"

	config USART_SAM_PORT_0_PIN_TXD_PB15
		bool "PB15"

	config USART_SAM_PORT_0_PIN_TXD_PC3
		bool "PC3"

endchoice

# ---------- Port 1 ----------

choice USART_SAM_PORT_1_PIN_RTS
	prompt "RTS pin"
	depends on SOC_SERIES_SAM4L
	depends on USART_SAM_PORT_1

	config USART_SAM_PORT_1_PIN_RTS_PA13
		bool "PA13"

	config USART_SAM_PORT_1_PIN_RTS_PB2
		bool "PB2"

	config USART_SAM_PORT_1_PIN_RTS_PC24
		bool "PC24"

endchoice

choice USART_SAM_PORT_1_PIN_CLK
	prompt "CLK pin"
	depends on SOC_SERIES_SAM4L
	depends on USART_SAM_PORT_1

	config USART_SAM_PORT_1_PIN_CLK_PA14
		bool "PA14"

	config USART_SAM_PORT_1_PIN_CLK_PB3
		bool "PB3"

	config USART_SAM_PORT_1_PIN_CLK_PC25
		bool "PC25"

endchoice

choice USART_SAM_PORT_1_PIN_RXD
	prompt "RXD pin"
	depends on SOC_SERIES_SAM4L
	depends on USART_SAM_PORT_1

	config USART_SAM_PORT_1_PIN_RXD_PA15
		bool "PA15"

	config USART_SAM_PORT_1_PIN_RXD_PB4
		bool "PB4"

	config USART_SAM_PORT_1_PIN_RXD_PC26
		bool "PC26"

endchoice

choice USART_SAM_PORT_1_PIN_TXD
	prompt "TXD pin"
	depends on SOC_SERIES_SAM4L
	depends on USART_SAM_PORT_1

	config USART_SAM_PORT_1_PIN_TXD_PA16
		bool "PA16"

	config USART_SAM_PORT_1_PIN_TXD_PB5
		bool "PB5"

	config USART_SAM_PORT_1_PIN_TXD_PC27
		bool "PC27"

endchoice

# ---------- Port 2 ----------

choice USART_SAM_PORT_2_PIN_RTS
	prompt "RTS pin"
	depends on SOC_SERIES_SAM4L
	depends on USART_SAM_PORT_2

	config USART_SAM_PORT_2_PIN_RTS_PA17
		bool "PA17"

	config USART_SAM_PORT_2_PIN_RTS_PC7
		bool "PC7"

endchoice

choice USART_SAM_PORT_2_PIN_CTS
	prompt "CTS pin"
	depends on SOC_SERIES_SAM4L
	depends on USART_SAM_PORT_2

	config USART_SAM_PORT_2_PIN_CTS_PA22
		bool "PA22"

	config USART_SAM_PORT_2_PIN_CTS_PC8
		bool "PC8"

endchoice

choice USART_SAM_PORT_2_PIN_CLK
	prompt "CLK pin"
	depends on SOC_SERIES_SAM4L
	depends on USART_SAM_PORT_2

	config USART_SAM_PORT_2_PIN_CLK_PA18
		bool "PA18"

	config USART_SAM_PORT_2_PIN_CLK_PC8
		bool "PC8"

endchoice

choice USART_SAM_PORT_2_PIN_RXD
	prompt "RXD pin"
	depends on SOC_SERIES_SAM4L
	depends on USART_SAM_PORT_2

	config USART_SAM_PORT_2_PIN_RXD_PA19
		bool "PA19"

	config USART_SAM_PORT_2_PIN_RXD_PA25
		bool "PA25"

	config USART_SAM_PORT_2_PIN_RXD_PC11
		bool "PC11"

endchoice

choice USART_SAM_PORT_2_PIN_TXD
	prompt "TXD pin"
	depends on SOC_SERIES_SAM4L
	depends on USART_SAM_PORT_2

	config USART_SAM_PORT_2_PIN_TXD_PA20
		bool "PA20"

	config USART_SAM_PORT_2_PIN_TXD_PA26
		bool "PA26"

	config USART_SAM_PORT_3_PIN_TXD_PC12
		bool "PC12"

endchoice

# ---------- Port 3 ----------

choice USART_SAM_PORT_3_PIN_RTS
	prompt "RTS pin"
	depends on SOC_SERIES_SAM4L
	depends on USART_SAM_PORT_3

	config USART_SAM_PORT_3_PIN_RTS_PA27
		bool "PA27"

	config USART_SAM_PORT_3_PIN_RTS_PB6
		bool "PB6"

	config USART_SAM_PORT_3_PIN_RTS_PC13
		bool "PC13"

	config USART_SAM_PORT_3_PIN_RTS_PC30
		bool "PC30"

endchoice

choice USART_SAM_PORT_3_PIN_CTS
	prompt "CTS pin"
	depends on SOC_SERIES_SAM4L
	depends on USART_SAM_PORT_3

	config USART_SAM_PORT_3_PIN_CTS_PA28
		bool "PA28"

	config USART_SAM_PORT_3_PIN_CTS_PB7
		bool "PB7"

endchoice

choice USART_SAM_PORT_3_PIN_CLK
	prompt "CLK pin"
	depends on SOC_SERIES_SAM4L
	depends on USART_SAM_PORT_3

	config USART_SAM_PORT_3_PIN_CLK_PA29
		bool "PA29"

	config USART_SAM_PORT_3_PIN_CLK_PB8
		bool "PB8"

	config USART_SAM_PORT_3_PIN_CLK_PC14
		bool "PC14"

	config USART_SAM_PORT_3_PIN_CLK_PC31
		bool "PC31"

endchoice

choice USART_SAM_PORT_3_PIN_RXD
	prompt "RXD pin"
	depends on SOC_SERIES_SAM4L
	depends on USART_SAM_PORT_3

	config USART_SAM_PORT_3_PIN_RXD_PA30
		bool "PA30"

	config USART_SAM_PORT_3_PIN_RXD_PB9
		bool "PB9"

	config USART_SAM_PORT_3_PIN_RXD_PC9
		bool "PC9"

	config USART_SAM_PORT_3_PIN_RXD_PC28
		bool "PC28"

endchoice

choice USART_SAM_PORT_3_PIN_TXD
	prompt "TXD pin"
	depends on SOC_SERIES_SAM4L
	depends on USART_SAM_PORT_3

	config USART_SAM_PORT_3_PIN_TXD_PA31
		bool "PA31"

	config USART_SAM_PORT_3_PIN_TXD_PB10
		bool "PB10"

	config USART_SAM_PORT_3_PIN_TXD_PC10
		bool "PC10"

	config USART_SAM_PORT_3_PIN_TXD_PC29
		bool "PC29"

endchoice
```

## drivers/sigfox/Kconfig
```kconfig
#
# Copyright (c) 2020 Gerson Fernando Budke
#
# SPDX-License-Identifier: Apache-2.0
#

# Top-level configuration file for SIGFOX drivers.

menuconfig SIGFOX
	bool "Sigfox support [EXPERIMENTAL]"
	select TINYCRYPT
	select TINYCRYPT_AES
	select TINYCRYPT_AES_CBC
	help
	  Include Sigfox drivers in the system configuration.

if SIGFOX

module = SIGFOX
module-str = sigfox
source "subsys/logging/Kconfig.template.log_config"

config SIGFOX_MONARCH_FEATURE
	bool "Sigfox Monarc API support"
	help
	  The Sigfox Monarch feature makes IoT devices aware of the local
	  radio configuration (RC) to use. A single device can thus lawfully
	  communicate on the Sigfox network even when moving between countries
	  with different radio regulations.
	  Monarch is transparent and simple since the device automatically
	  chooses the appropriate radio configuration without human
	  intervention.

config SIGFOX_API_ADDONS
	bool "Sigfox Add-On API support"
	help
	  Enable Sigfox Add-On functions

config SIGFOX_INIT_PRIO
	int "Sigfox initialization priority"
	default 80
	help
	  System initialization priority for Sigfox drivers.

endif # SIGFOX
```
