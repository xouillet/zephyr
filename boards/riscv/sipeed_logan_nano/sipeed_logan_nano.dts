/*
 * Copyright (c) 2021, ATL Electronics
 *
 * SPDX-License-Identifier: Apache-2.0
 */

/dts-v1/;

#include <gigadevice/gd32vf103cbt6.dtsi>

/ {
	model = "Sipeed Logan Nano with GigaDevice GD32VF103CBT6";
	compatible = "gigadevice,gd32vf103cbt6";

	chosen {
		zephyr,sram = &sram0;
		zephyr,flash = &flash0;
		zephyr,console = &usart0;
		zephyr,shell-uart = &usart0;
	};
};

&usart0 {
	status = "okay";
};
